## CMakeLists.txt
```
# Copyright (c) 2026 Open Device Partnership and Contributors
# SPDX-License-Identifier: MIT

cmake_minimum_required(VERSION 3.20.0)

set(BOARD native_sim/native/64 CACHE STRING "Default board for Pico de Gallo samples")
set(SHIELD pico_de_gallo CACHE STRING "Default shield for Pico de Gallo samples")
get_filename_component(PDG_MODULE_ROOT "${CMAKE_CURRENT_LIST_DIR}/../../.." ABSOLUTE)
list(APPEND EXTRA_ZEPHYR_MODULES "${PDG_MODULE_ROOT}")

find_package(Zephyr REQUIRED HINTS $ENV{ZEPHYR_BASE})
project(pdg_uart_bridge)

target_sources(app PRIVATE src/main.c)
```

## prj.conf
```kconfig
CONFIG_SERIAL=y
CONFIG_LOG=y

# Both of these are `default y` once the matching devicetree node is enabled,
# so app.overlay alone would turn them on. They are stated explicitly because
# this sample exists to document the UART path: a reader should not have to
# derive the driver symbol from a DT_HAS_* dependency in drivers/serial/Kconfig.
CONFIG_MFD_PICO_DE_GALLO=y
CONFIG_UART_PICO_DE_GALLO=y

# Deliberately NOT set: CONFIG_EARLY_CONSOLE. The Pico de Gallo UART
# initialises at POST_KERNEL, while the early console hook installs at
# PRE_KERNEL_1 and checks device readiness, so the driver rejects the
# combination at build time when it is also zephyr,console. This sample never
# makes it the console, but leaving the symbol off keeps the example honest.
```

## app.overlay
```dts
/*
 * Copyright (c) 2026 Open Device Partnership and Contributors
 *
 * SPDX-License-Identifier: MIT
 */

&pdg0 {
	status = "okay";

	/*
	 * REQUIRED: replace this placeholder with this board's serial from
	 * `gallo list`. The UART controller drives two physical pads, so its
	 * binding refuses a selector-less parent at build time: transmitting
	 * onto the wrong board's TX pin is the same class of mistake as
	 * driving the wrong board's chip select.
	 *
	 * Presence is not uniqueness. Two parents carrying the same explicit
	 * value still alias to one board.
	 */
	serial-number = "REPLACE_WITH_YOUR_PICO_DE_GALLO_SERIAL";
};

&pdg_uart0 {
	status = "okay";

	/*
	 * 115200 8N1, stated in full. `parity` has a binding-level default,
	 * but current-speed, data-bits and stop-bits do not: the driver falls
	 * back through DT_INST_PROP_OR / DT_INST_ENUM_IDX_OR. Spelling all
	 * four out here keeps the configured framing visible in one place
	 * rather than split between the overlay and the driver's fallbacks.
	 */
	current-speed = <115200>;
	data-bits = <8>;
	parity = "none";
	stop-bits = "1";
};
```

## src/main.c
```c
/*
 * Copyright (c) 2026 Open Device Partnership and Contributors
 *
 * SPDX-License-Identifier: MIT
 *
 * Small sample for the Pico de Gallo UART controller. Sends a fixed greeting
 * with uart_poll_out(), then makes a bounded number of uart_poll_in()
 * attempts and prints whatever arrived, before returning.
 *
 * The driver implements only the polling API. uart_poll_out() is void and
 * makes one uart/write round trip per byte; uart_poll_in() returns exactly 0
 * or exactly -1, and writes through its output pointer only when it returns 0.
 * -1 exposes no byte. It does not distinguish an idle line from a local
 * refusal or a transport failure -- uart_poll_in()'s contract has no room
 * for an errno, and the driver latches the real one privately. This sample
 * counts the attempt and keeps going.
 *
 * Everything here is bounded at compile time. There is no unconditional loop:
 * the program always reaches `return 0`, which matters because the sample is
 * built for native_sim and a hung binary would wedge whoever ran it.
 */

#include <errno.h>

#include <zephyr/kernel.h>
#include <zephyr/device.h>
#include <zephyr/drivers/uart.h>

/* Greeting sent byte-by-byte. sizeof() - 1 drops the NUL terminator. */
static const char greeting[] = "Hello from Pico de Gallo!\r\n";
#define GREETING_LEN (sizeof(greeting) - 1U)

/* Receive attempts before giving up. Fixed at compile time on purpose. */
#define RX_ATTEMPTS 64U

/* Pause between receive attempts, so the cap spans a usable wall-clock span. */
#define RX_INTERVAL_MS 10U

int main(void)
{
	const struct device *uart = DEVICE_DT_GET(DT_NODELABEL(pdg_uart0));
	unsigned char rx[RX_ATTEMPTS];
	size_t received = 0U;

	if (!device_is_ready(uart)) {
		printk("Pico de Gallo UART not ready: check that the board is "
		       "attached and that serial-number in app.overlay names "
		       "it\n");
		return -ENODEV;
	}

	printk("Sending %u bytes\n", (unsigned int)GREETING_LEN);
	for (size_t i = 0U; i < GREETING_LEN; i++) {
		/*
		 * void return: a dropped byte cannot be reported here. The
		 * driver counts it privately and deliberately never logs,
		 * since logging through this same UART would recurse.
		 */
		uart_poll_out(uart, (unsigned char)greeting[i]);
	}

	printk("Polling for input, up to %u attempts\n",
	       (unsigned int)RX_ATTEMPTS);
	for (unsigned int attempt = 0U; attempt < RX_ATTEMPTS; attempt++) {
		unsigned char c;

		if (uart_poll_in(uart, &c) == 0) {
			rx[received++] = c;
			continue;
		}

		/*
		 * -1: no byte exposed. Could be an idle line, a local
		 * refusal, or a transport failure -- the polling contract
		 * cannot say which. Not fatal; retry within the bound.
		 */
		k_sleep(K_MSEC(RX_INTERVAL_MS));
	}

	if (received == 0U) {
		printk("No bytes received in %u attempts\n",
		       (unsigned int)RX_ATTEMPTS);
		return 0;
	}

	printk("Received %u bytes:", (unsigned int)received);
	for (size_t i = 0U; i < received; i++) {
		printk(" %02x", rx[i]);
	}
	printk("\n");

	return 0;
}
```
