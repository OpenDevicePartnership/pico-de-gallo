## CMakeLists.txt
```
# Copyright (c) 2026 Open Device Partnership and Contributors
# SPDX-License-Identifier: MIT

cmake_minimum_required(VERSION 3.20.0)

set(BOARD native_sim/native/64 CACHE STRING "Default board for Pico de Gallo tests")
set(SHIELD pico_de_gallo CACHE STRING "Default shield for Pico de Gallo tests")
get_filename_component(PDG_MODULE_ROOT "${CMAKE_CURRENT_LIST_DIR}/../../../.." ABSOLUTE)
list(APPEND EXTRA_ZEPHYR_MODULES "${PDG_MODULE_ROOT}")

find_package(Zephyr REQUIRED HINTS $ENV{ZEPHYR_BASE})
project(pdg_fake_i2c)

target_sources(app PRIVATE src/main.c)

# The embedded side calls the fake's accessors, so it needs the FFI-free header.
target_include_directories(app PRIVATE ${CMAKE_CURRENT_LIST_DIR}/../common)

# The fake itself runs in the host context, and provides STRONG definitions that
# override the weak ones in drivers/common/common.c and drivers/i2c/
# pdg_i2c_bottom.c. Same mechanism as zephyr/drivers/CMakeLists.txt.
target_sources(native_simulator INTERFACE ${CMAKE_CURRENT_LIST_DIR}/../common/pdg_fake_bottom.c)

# Header search path for the fake. It needs its own directory, plus the
# production declaration sites of every symbol it overrides -- included rather
# than hand-copied so a signature drift is a compile error rather than
# undefined behaviour that links cleanly. All three headers are FFI-free
# (stdint/stddef only), so none of this drags pico_de_gallo.h in.
#
# This MUST be target_compile_options("-I...") and NOT the natural-looking
# target_include_directories(native_simulator INTERFACE ...). The fake is
# compiled by the native-simulator Makefile, not by CMake, and
# boards/native/common/natsim_config.cmake joins only INTERFACE_COMPILE_OPTIONS
# into NSI_BUILD_OPTIONS -- INTERFACE_INCLUDE_DIRECTORIES is never consumed and
# the flag silently vanishes. Same channel, and same reason, as
# zephyr/drivers/CMakeLists.txt:32-34. Do not "tidy" this back; it has already
# cost one red CI run (33106107101).
#
# Two things look like counter-evidence and are not. zephyr/drivers/i2c/
# CMakeLists.txt uses the include-directories form, but pdg_i2c_bottom.c and
# pdg_i2c_bottom.h sit in the same directory, so quoted-include lookup finds
# the header with no -I at all. And common_bottom.h resolves in the drivers
# build only because zephyr/drivers/CMakeLists.txt injects that directory with
# this same -I mechanism.
target_compile_options(native_simulator INTERFACE
  "-I${CMAKE_CURRENT_LIST_DIR}/../common"
  "-I${PDG_MODULE_ROOT}/zephyr/drivers/common"
  "-I${PDG_MODULE_ROOT}/zephyr/drivers/i2c")
```

## prj.conf
```kconfig
# Copyright (c) 2026 Open Device Partnership and Contributors
# SPDX-License-Identifier: MIT

CONFIG_ZTEST=y
CONFIG_I2C=y
CONFIG_LOG=y
CONFIG_LOG_MODE_IMMEDIATE=y

# Disabled in fake.overlay; stated explicitly so an accidental re-enable is
# visible in review, matching the convention in the other test prj.conf files.
CONFIG_GPIO=n
CONFIG_SPI=n
```

## fake.overlay
```dts
/*
 * Copyright (c) 2026 Open Device Partnership and Contributors
 *
 * SPDX-License-Identifier: MIT
 *
 * Topology for the recording-fake suite: parent and I2C okay, nothing else.
 *
 * Mirrors zephyr/tests/pdg_i2c_burst/burst.overlay, minus the commentary about
 * physical boards, because this image never reaches one.
 *
 * No FFI call occurs, and the reason is specific rather than general: every
 * bottom entry point the init path for this topology touches has a strong
 * override in tests/pdg_fake/common/pdg_fake_bottom.c. That is
 * pdg_common_bottom_open()/_close(), which keeps pdg_mfd_init() out of
 * gallo_init_strict(), plus pdg_i2c_bottom_set_config(), which pdg_i2c_init()
 * calls unconditionally and which would otherwise hand the fake's opaque
 * token to the real gallo_i2c_set_config().
 *
 * That guarantee is scoped to this overlay. Enabling the GPIO or SPI child
 * would add bottom entry points that are NOT overridden, and the fake's token
 * would reach the FFI.
 *
 * GPIO and SPI stay disabled. An enabled SPI controller would additionally
 * park every cs-gpios pin as an inactive output at init, which this suite has
 * no reason to provoke.
 *
 * No target device node is declared. No real bus traffic occurs, so there is
 * no peer for one to describe.
 *
 * No serial-number is declared. The fake ignores the selector entirely, and
 * only GPIO and SPI children require the parent to name one.
 */

&pdg0 {
	status = "okay";
};

&pdg_i2c0 {
	status = "okay";
};
```

## src/main.c
```c
/*
 * Copyright (c) 2026 Open Device Partnership and Contributors
 *
 * SPDX-License-Identifier: MIT
 */

#include <zephyr/ztest.h>
#include <zephyr/device.h>
#include <zephyr/drivers/i2c.h>

#include "pdg_fake_bottom.h"

ZTEST_SUITE(pdg_fake_i2c, NULL, NULL, NULL, NULL, NULL);

/*
 * The load-bearing test of the whole design. If the fake's strong
 * pdg_common_bottom_open() did not override the weak one in
 * drivers/common/common.c, the real one runs, reaches gallo_init_strict(),
 * finds no board, and the parent is not ready -- so this fails at the
 * device_is_ready() assertion rather than at the count.
 *
 * The open happens during POST_KERNEL device init, before any ztest setup
 * hook runs, so the count it produces cannot be re-established by a test.
 * pdg_fake_open_count() is latched against pdg_fake_reset() for exactly that
 * reason, which is what keeps this assertion independent of test order once
 * later suites start calling reset.
 */
ZTEST(pdg_fake_i2c, test_weak_override_replaces_the_bottom_layer)
{
	const struct device *dev = DEVICE_DT_GET(DT_NODELABEL(pdg_i2c0));

	zassert_true(device_is_ready(dev),
		     "I2C child not ready: the real bottom layer probably ran "
		     "and tried to open a USB device");
	zassert_true(pdg_fake_open_count() > 0,
		     "the fake's pdg_common_bottom_open() was never called, so "
		     "the weak override did not take effect");
}

/*
 * Regression coverage for #102. i2c_burst_write() emits WRITE followed by
 * WRITE | STOP, and the driver must concatenate the two into ONE bus write.
 * Before the #102 fix the grouping refused that shape with -ENOTSUP.
 *
 * This is the first automated coverage of that regression: the pre-existing
 * zephyr/tests/pdg_i2c_burst suite needs an attached board, so CI only ever
 * built and linked it.
 */
ZTEST(pdg_fake_i2c, test_gather_write_concatenates_into_one_transfer)
{
	const struct device *dev = DEVICE_DT_GET(DT_NODELABEL(pdg_i2c0));
	uint8_t reg = 0x02;
	uint8_t val[2] = { 0x03, 0x00 };
	struct i2c_msg msgs[2] = {
		{ .buf = &reg,  .len = 1U, .flags = I2C_MSG_WRITE },
		{ .buf = val,   .len = 2U, .flags = I2C_MSG_WRITE | I2C_MSG_STOP },
	};
	uint8_t seen[8];
	uint16_t addr = 0U;
	int len;

	pdg_fake_reset();
	zassert_ok(i2c_transfer(dev, msgs, 2U, 0x48));

	zassert_equal(pdg_fake_i2c_write_count(), 1,
		      "expected exactly one bus write, saw %d",
		      pdg_fake_i2c_write_count());
	zassert_equal(pdg_fake_i2c_write_read_count(), 0,
		      "the gather path must issue a plain write, not a write-read");

	len = pdg_fake_i2c_last_write(&addr, seen, sizeof(seen));
	zassert_equal(len, 3, "expected a 3-byte payload, saw %d", len);
	zassert_equal(addr, 0x48, "wrong target address");
	zassert_equal(seen[0], 0x02);
	zassert_equal(seen[1], 0x03);
	zassert_equal(seen[2], 0x00);
}
```
