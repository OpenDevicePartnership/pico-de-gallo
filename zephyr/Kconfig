## zephyr/dts/bindings/gpio/odp,pico-de-gallo-gpio.yaml
```yaml
# Copyright (c) 2026 Open Device Partnership and Contributors
# SPDX-License-Identifier: MIT

description: |
  Pico de Gallo USB-attached GPIO controller.

  This controller forwards Zephyr GPIO API calls to a Pico de Gallo USB bridge
  connected to the host running native_sim.

  Topology. This controller must be a direct child of an enabled
  odp,pico-de-gallo MFD parent. It borrows the parent's host connection and
  inherits the parent's board selection; serial-number is not valid on the
  child controller. A controller that is not a direct child of an enabled
  odp,pico-de-gallo node is rejected at build time.

  Board identity is mandatory. Because this controller actuates physical pins,
  the parent of every enabled GPIO child must define serial-number. A
  selector-less connection cannot report which attached board it selected, so
  it would actuate unidentifiable hardware; that case is rejected at build
  time. Presence is not uniqueness: two parents carrying the same explicit
  serial-number still alias to one board. The configured serial-number is
  logged on successful GPIO initialization.

  Blocking. Every operation that reaches hardware is a blocking USB round trip.
  Calls rejected before any I/O -- interrupt context, invalid arguments, a zero
  pin mask, and toggle -- do not reach the bridge at all. Calls made from
  interrupt context return -EWOULDBLOCK without touching hardware. A transport
  failure is reported as -EIO. Configuration and writes can also return -EBUSY
  when a live firmware event subscription owns the pin. Writes can return
  -EACCES when the firmware records the pin as an explicit input. While scanning
  the port, gpio_pin_get() normalizes subscription -EBUSY to -EIO and treats
  -EACCES from an explicit output as a zero bit.

  Supported configuration flags. A pin is either an input or an output.
  GPIO_DISCONNECTED, and GPIO_INPUT | GPIO_OUTPUT together, return -ENOTSUP.
  Pull resistors none, up and down are supported; requesting both pulls
  returns -EINVAL. Single-ended drive, open-source and open-drain return
  -ENOTSUP. Interrupt-mode flags, including GPIO_INT_WAKEUP, return -ENOTSUP,
  as does any flag bit outside the supported set. Requesting both output
  initialization levels, or an initialization level without GPIO_OUTPUT,
  returns -EINVAL. GPIO_ACTIVE_LOW is supported and handled by Zephyr's common
  GPIO layer.

  ngpios is required and must equal the firmware-reported GPIO count from
  device/info. A mismatch is a local devicetree/firmware configuration error
  and fails initialization with -EINVAL. Zephyr evaluates the
  devicetree-derived pin mask assertion before dispatching to this driver, so
  an out-of-range pin normally fails there first.

  Non-atomicity. Multi-pin writes are deterministic ascending, non-atomic,
  per-pin USB round trips. On a partial failure the acknowledged prefix
  definitely changed, the failed pin is indeterminate because its request may
  have executed with only the response lost, and later selected pins were never
  issued; the driver logs the operation, the failed pin, the requested mask and
  value, and the acknowledged prefix, and does not roll back. Output
  initialization is likewise two non-atomic round trips: the pin becomes an
  output before the requested level arrives, so the previous or HAL-defined
  level may briefly appear. After a failed pin_configure, the requested
  direction and pull may nevertheless have been applied, and logical polarity
  is unreliable until a successful reconfiguration.

  Reads are scoped to input pins. A pin the firmware has recorded as an
  explicit output contributes a zero bit and the scan continues, exactly as
  Zephyr's reference controller behaves. This is only sound because
  GPIO_INPUT | GPIO_OUTPUT is rejected, so a reported zero is provably not an
  input pin. Direction-query APIs are unavailable on this controller;
  gpio_pin_is_input() and gpio_pin_is_output() return -ENOSYS.

  Reads are not state-neutral. gpio_port_get_raw() scans every pin, and reading
  a LegacyAuto pin invokes firmware gpio/get, which switches that pad to input.
  Consequently gpio_pin_get() can reconfigure unrelated unconfigured pins as a
  side effect. Configure every pin explicitly before reading.

  Unsupported operations. Interrupt configuration, callback management and the
  pending-interrupt query are not implemented and return -ENOSYS. Toggle
  dispatch exists but returns -ENOTSUP: an explicit output cannot be read back
  and no pin state is cached. Generic toggle consumers, including blinky, the
  GPIO shell, the TPS382x watchdog and the LS0xx display, therefore do not work
  with this controller.

compatible: "odp,pico-de-gallo-gpio"

include: [gpio-controller.yaml, base.yaml]

properties:
  ngpios:
    required: true

  "#gpio-cells":
    const: 2

gpio-cells:
  - pin
  - flags
```

## zephyr/dts/bindings/i2c/odp,pico-de-gallo-i2c.yaml
```yaml
# Copyright (c) 2026 Open Device Partnership and Contributors
# SPDX-License-Identifier: MIT

description: |
  Pico de Gallo USB-attached I2C controller.

  This controller forwards Zephyr I2C API calls to a Pico de Gallo USB bridge
  connected to the host running native_sim. Devices on the bus are declared as
  ordinary child nodes using their own vendor,device compatible.

  This controller must be a direct child of an enabled odp,pico-de-gallo MFD
  parent. It borrows the parent's host connection and inherits the parent's
  serial-number board selection; serial-number is not valid on the child
  controller. A controller that is not a direct child of an enabled
  odp,pico-de-gallo node is rejected at build time.

compatible: "odp,pico-de-gallo-i2c"

include: i2c-controller.yaml
```

## zephyr/dts/bindings/mfd/odp,pico-de-gallo.yaml
```yaml
# Copyright (c) 2026 Open Device Partnership and Contributors
# SPDX-License-Identifier: MIT

description: |
  Pico de Gallo USB-attached multi-function device.

  This node represents one physical USB-attached Pico de Gallo board. It owns
  the host connection to that board and exposes the peripheral controllers it
  provides, such as I2C, SPI and GPIO, as children.

  Parent initialization uses the strict host open and can block for as long as
  300 seconds. All child controllers remain unavailable during that interval;
  this is the expected worst-case timeout behaviour, not proof of a hang.

compatible: "odp,pico-de-gallo"

include: base.yaml

properties:
  serial-number:
    type: string
    description: |
      Optional USB serial number selecting the physical Pico de Gallo board
      that this parent represents. The selection applies to all child
      peripheral controllers, which borrow this parent's host connection and
      must not carry a selector of their own.

      If omitted, the first matching board is selected, but the host API
      cannot report which serial number it chose. Omission is therefore safe
      only when exactly one matching Pico de Gallo board is physically
      attached. With multiple matching boards attached, a selector-less parent
      and all of its children can become ready against the wrong board without
      any diagnostic; the build-time check below counts devicetree parents, not
      attached USB devices, so it cannot detect this. Any multi-board host
      environment must set an explicit serial-number on every enabled parent.

      At most one enabled parent may omit this property; a build-time
      assertion rejects multiple enabled selector-less parents, because they
      all normalise to the same registry key and would silently alias to one
      board. That check verifies property presence, not value uniqueness: two
      parents carrying the same explicit value still resolve to one board and
      silently alias. Devicetree authors must ensure explicit values are
      distinct.
```

## zephyr/dts/bindings/pwm/odp,pico-de-gallo-pwm.yaml
```yaml
# Copyright (c) 2026 Open Device Partnership and Contributors
# SPDX-License-Identifier: MIT

description: |
  PWM controller bridged over USB by a Pico de Gallo board.

  Must be a direct child of an odp,pico-de-gallo parent, which owns the host
  connection and the serial-number selector. This node must not carry a
  selector of its own.

  Four channels, 0 to 3, mapping to GPIO12 through GPIO15 on the Pico 2
  header.

  SLICE SHARING. The RP2350 groups channels into slices of two: channels 0
  and 1 share one slice, channels 2 and 3 share another. A slice has a single
  period. Two channels on the same slice therefore CANNOT hold independent
  periods, and this driver refuses the attempt with -EINVAL rather than
  silently changing a period its owner never asked for. Plan for one period
  per slice, or use channels 0 and 2 if two independent periods are required.

  NO DISABLE. The firmware's disable operation acts on a whole slice, so
  disabling one channel would stop its sibling mid-operation. This driver
  therefore enables a slice on first use and never disables it. A pulse width
  of zero already produces a constant-low output, which is what "off" means
  here.

  UNSUPPORTED FLAGS. PWM_POLARITY_INVERTED returns -ENOTSUP. It is not
  emulated by inverting the duty cycle, because that changes the idle level
  rather than the polarity.

  PERIOD BOUNDS. pwm_get_cycles_per_sec() reports the 150 MHz PWM source
  clock, so period_cycles are source-clock ticks. A period below 2 cycles is
  refused with -EINVAL. A period above 16711680 cycles (roughly 9 Hz) is
  refused with -ENOTSUP: a longer period would require a clock divider the
  firmware cannot program, and requesting one panics the firmware. See
  https://github.com/OpenDevicePartnership/pico-de-gallo/issues/192.

  PHASE-CORRECT mode is never used. Zephyr has no corresponding concept, and
  in that mode the firmware's reported full-scale duty no longer corresponds
  to the period.

compatible: "odp,pico-de-gallo-pwm"

include: [pwm-controller.yaml, base.yaml]

properties:
  "#pwm-cells":
    const: 3

pwm-cells:
  - channel
  - period
  - flags
```
