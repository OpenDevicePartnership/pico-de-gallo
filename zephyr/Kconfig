## zephyr/Kconfig
```kconfig
menu "Pico de Gallo"

config PICO_DE_GALLO
    bool "Pico de Gallo host bridge"
    depends on ARCH_POSIX
    depends on 64BIT
  default y if DT_HAS_ODP_PICO_DE_GALLO_I2C_ENABLED || DT_HAS_ODP_PICO_DE_GALLO_SPI_ENABLED
    help
      Enable support for Pico de Gallo host peripheral bridges.

if PICO_DE_GALLO

# Keep zephyr tickrate consistent with embassy tickrate
config SYS_CLOCK_TICKS_PER_SEC
    default 10000

source "$(ZEPHYR_PICO_DE_GALLO_MODULE_DIR)/zephyr/drivers/Kconfig"

endif

endmenu
```

## zephyr/boards/shields/pico_de_gallo/Kconfig.shield
```kconfig
# Copyright (c) 2026 Open Device Partnership and Contributors
# SPDX-License-Identifier: MIT

config SHIELD_PICO_DE_GALLO
	def_bool $(shields_list_contains,pico_de_gallo)
```

## zephyr/drivers/Kconfig
```kconfig
# Copyright (c) 2026 Open Device Partnership and Contributors
# SPDX-License-Identifier: MIT

rsource "mfd/Kconfig"
rsource "gpio/Kconfig"
rsource "i2c/Kconfig"
rsource "spi/Kconfig"
```

## zephyr/drivers/gpio/Kconfig
```kconfig
# Copyright (c) 2026 Open Device Partnership and Contributors
# SPDX-License-Identifier: MIT

config GPIO_PICO_DE_GALLO
	bool "Pico de Gallo GPIO controller"
	default y
	depends on DT_HAS_ODP_PICO_DE_GALLO_GPIO_ENABLED
	depends on ARCH_POSIX
	select GPIO
	help
	  Enable the Pico de Gallo GPIO controller driver. This driver forwards
	  Zephyr GPIO API calls to a Pico de Gallo USB bridge attached to the
	  host running native_sim via the Pico de Gallo C FFI. Every operation
	  that reaches hardware is a blocking USB round trip; calls rejected
	  beforehand (interrupt context, invalid arguments, zero pin masks and
	  toggle) perform no I/O. Interrupts and toggle are unavailable.

if GPIO_PICO_DE_GALLO

config GPIO_PICO_DE_GALLO_INIT_PRIORITY
	int "Pico de Gallo GPIO controller initialization priority"
	default 45
	help
	  POST_KERNEL initialization priority of the Pico de Gallo GPIO
	  controller. It must run after the odp,pico-de-gallo MFD parent
	  (default 40) and before the I2C and SPI controllers (default 50), so
	  that a later SPI chip-select consumer finds this port ready.

endif # GPIO_PICO_DE_GALLO
```

## zephyr/drivers/i2c/Kconfig
```kconfig
# Copyright (c) 2026 Open Device Partnership and Contributors
# SPDX-License-Identifier: MIT

config I2C_PICO_DE_GALLO
	bool "Pico de Gallo I2C controller"
	default y
	depends on DT_HAS_ODP_PICO_DE_GALLO_I2C_ENABLED
	depends on ARCH_POSIX
	select I2C
	help
	  Enable the Pico de Gallo I2C controller driver. This driver forwards
	  Zephyr I2C API calls to a Pico de Gallo USB bridge attached to the host
	  running native_sim via the Pico de Gallo C FFI.

config I2C_PICO_DE_GALLO_PROBE_WITH_READ
	bool "Substitute a 1-byte read for an address-only I2C probe"
	depends on I2C_PICO_DE_GALLO
	help
	  The RP2040/RP2350 I2C block cannot emit an address-only transaction:
	  the address phase is driven solely by pushing data bytes, so
	  START + ADDR + STOP is physically unreachable (rp-rs/rp-hal#678,
	  embassy-rs/embassy#4474). A STOP-delimited group carrying no data
	  bytes in either direction therefore cannot be performed as asked, and
	  without this option the driver returns -ENOTSUP for it.

	  Enable this to have the driver substitute a 1-byte read to the same
	  address instead: an ACK means the device is present, a NACK surfaces
	  as -ENXIO. That makes Zephyr's shell "i2c scan" work, at the cost of
	  one blocking USB round trip per address.

	  Two caveats. A write-only device may acknowledge its write address
	  while NACKing its read address, so a scan performed this way can
	  under-report. And the substituted read consumes a byte, which can pop
	  a FIFO or step an EEPROM address pointer. Zephyr's own i2c_shell.c
	  carries the same warning about read-based scanning. This is why the
	  option is off by default: a bus scan is a deliberate act, whereas a
	  driver silently turning every zero-length write into a read is not.

	  gallo i2c scan, or the firmware's i2c/scan endpoint, probes the whole
	  bus in one round trip and does not need this option.

config HEAP_MEM_POOL_ADD_SIZE_PDG_I2C
	int "Heap memory pool size for the Pico de Gallo I2C driver"
	default 8192
	depends on I2C_PICO_DE_GALLO
	help
	  pdg_i2c_transfer() merges the write messages of a STOP-delimited group
	  into one contiguous payload with k_malloc() so that the group reaches
	  the bus as a single transaction, which is what i2c_burst_write() and
	  every hand-rolled gather write require. At most one such buffer is live
	  at a time, of at most PDG_I2C_MAX_BUFFER (4096) bytes, so 8192 leaves a
	  large margin over the allocation plus sys_heap per-chunk metadata, the
	  heap header and alignment padding.

	  Nothing is allocated on the common paths. A group holding a single
	  message, a single write followed by a read, or only empty writes is sent
	  straight from the caller's buffer with no copy. Only a group with two or
	  more non-empty writes allocates.

	  4096 is the firmware's declared argument bound
	  (pico_de_gallo_internal::MAX_TRANSFER_SIZE), not a measured end-to-end
	  ceiling for this transport. The sibling SPI driver settled on 1013 after
	  measuring that 4096 fails and 1015 wedges the firmware dispatcher; the
	  equivalent measurement for I2C has never been taken. See issue #146.

	  This has to be declared rather than assumed: k_malloc() lives in
	  kernel/mempool.c, which Zephyr only compiles when the system heap is
	  non-empty, and CONFIG_HEAP_MEM_POOL_SIZE defaults to 0. Without a
	  contribution here the driver fails to link with an undefined reference
	  to k_malloc. The kernel sums every HEAP_MEM_POOL_ADD_SIZE_* symbol and
	  raises the pool to fit, so applications do not have to set
	  CONFIG_HEAP_MEM_POOL_SIZE by hand.

	  Lower this if you know your gather writes are small.
```

## zephyr/drivers/mfd/Kconfig
```kconfig
# Copyright (c) 2026 Open Device Partnership and Contributors
# SPDX-License-Identifier: MIT

config MFD_PICO_DE_GALLO
	bool "Pico de Gallo MFD parent"
	default y
	depends on DT_HAS_ODP_PICO_DE_GALLO_ENABLED
	depends on ARCH_POSIX
	help
	  Enable the Pico de Gallo multi-function device parent. One enabled
	  node represents one physical USB-attached Pico de Gallo board. The
	  parent owns the host connection and exposes its opaque context to
	  child peripheral controller drivers.

if MFD_PICO_DE_GALLO

config MFD_PICO_DE_GALLO_INIT_PRIORITY
	int "Pico de Gallo MFD parent initialization priority"
	default KERNEL_INIT_PRIORITY_DEFAULT
	help
	  POST_KERNEL initialization priority of the Pico de Gallo MFD parent.
	  It must run after libc and before any child peripheral controller.

module = MFD_PICO_DE_GALLO
module-str = Pico de Gallo MFD parent
source "subsys/logging/Kconfig.template.log_config"

endif # MFD_PICO_DE_GALLO
```

## zephyr/drivers/pwm/Kconfig
```kconfig
# Copyright (c) 2026 Open Device Partnership and Contributors
# SPDX-License-Identifier: MIT

config PWM_PICO_DE_GALLO
	bool "Pico de Gallo PWM controller"
	default y
	depends on DT_HAS_ODP_PICO_DE_GALLO_PWM_ENABLED
	depends on ARCH_POSIX
	select PWM
	help
	  Enable the Pico de Gallo PWM controller driver. The controller is a
	  child of an odp,pico-de-gallo MFD parent and reaches the board over
	  USB, so every operation is a blocking host round trip.

if PWM_PICO_DE_GALLO

config PWM_PICO_DE_GALLO_INIT_PRIORITY
	int "Pico de Gallo PWM controller initialization priority"
	default 45
	help
	  POST_KERNEL initialization priority of the Pico de Gallo PWM
	  controller. It must be greater than
	  CONFIG_MFD_PICO_DE_GALLO_INIT_PRIORITY (default 40) so the parent has
	  opened its host connection first. PWM has no cross-child dependency,
	  so nothing constrains it from above.

endif # PWM_PICO_DE_GALLO
```

## zephyr/drivers/serial/Kconfig
```kconfig
# Copyright (c) 2026 Open Device Partnership and Contributors
# SPDX-License-Identifier: MIT

config UART_PICO_DE_GALLO
	bool "Pico de Gallo UART controller"
	default y
	depends on DT_HAS_ODP_PICO_DE_GALLO_UART_ENABLED
	depends on ARCH_POSIX
	select SERIAL
	select SERIAL_HAS_DRIVER
	help
	  Enable the Pico de Gallo UART controller driver. This driver forwards
	  Zephyr UART API calls to a Pico de Gallo USB bridge attached to the
	  host running native_sim via the Pico de Gallo C FFI.

	  Polling only. The asynchronous and interrupt-driven UART APIs are not
	  supported: the driver deliberately does not select
	  SERIAL_SUPPORT_ASYNC, SERIAL_SUPPORT_INTERRUPT or
	  SERIAL_SUPPORT_WIDE_DATA. Those symbols are global and another driver
	  in the same build may enable the corresponding API; this driver ships
	  side-effect-free stubs for the resulting callback slots so that such a
	  build fails loudly rather than dereferencing a NULL slot.

	  The controller is thread-context-only. Every operation that reaches
	  hardware is a blocking USB round trip, so no callback may be invoked
	  from an ISR or before the kernel is up. Those contexts are rejected
	  before any mutex is taken and before any FFI call is made: polling
	  input returns -1, polling output drops the character and increments a
	  dropped counter, and the remaining integer callbacks return
	  -EWOULDBLOCK in an ISR and -EAGAIN pre-kernel.

	  Reconfiguration is not atomic. The firmware's set_baudrate restores an
	  enabled UARTCR before returning, so there is a brief window in which
	  the new divisor is in effect while the old framing still applies.
	  Bytes already sitting in the firmware ring were decoded under the old
	  framing and cannot be told apart from new ones, and more may still
	  arrive after the driver clears its local staging. Callers must quiesce
	  and drain both directions before calling uart_configure().

	  The device cannot serve as an early console. It initializes at
	  POST_KERNEL, whereas the CONFIG_EARLY_CONSOLE hook installs at
	  PRE_KERNEL_1 and checks device readiness first, so the hook would
	  simply not be installed. Selecting this instance as the chosen
	  zephyr,console with CONFIG_EARLY_CONSOLE enabled is rejected at build
	  time.

if UART_PICO_DE_GALLO

config UART_PICO_DE_GALLO_INIT_PRIORITY
	int "Pico de Gallo UART controller initialization priority"
	default 50
	help
	  POST_KERNEL initialization priority of the Pico de Gallo UART
	  controller.

	  It must be greater than CONFIG_MFD_PICO_DE_GALLO_INIT_PRIORITY
	  (default 40): this controller borrows the host connection owned by its
	  odp,pico-de-gallo MFD parent, so the parent has to be ready first.
	  It shares the default 50 with the I2C and SPI controllers, which it
	  does not depend on.

	  Kconfig cannot check the arithmetic. Runtime readiness is
	  authoritative instead: an inverted priority makes initialization
	  return -ENODEV rather than using a parent that is not yet open.

endif # UART_PICO_DE_GALLO
```

## zephyr/drivers/spi/Kconfig
```kconfig
# Copyright (c) 2026 Open Device Partnership and Contributors
# SPDX-License-Identifier: MIT

config SPI_PICO_DE_GALLO
	bool "Pico de Gallo SPI controller"
	default y
	depends on DT_HAS_ODP_PICO_DE_GALLO_SPI_ENABLED
	depends on ARCH_POSIX
	select SPI
	help
	  Enable the Pico de Gallo SPI controller driver. This driver forwards
	  Zephyr SPI API calls to a Pico de Gallo USB bridge attached to the host
	  running native_sim via the Pico de Gallo C FFI.

config SPI_PICO_DE_GALLO_INIT_PRIORITY
	int "Pico de Gallo SPI controller initialization priority"
	default 50
	depends on SPI_PICO_DE_GALLO
	help
	  POST_KERNEL initialization priority of the Pico de Gallo SPI
	  controller.

	  It must be greater than CONFIG_GPIO_PICO_DE_GALLO_INIT_PRIORITY
	  (default 45), which must in turn be greater than
	  CONFIG_MFD_PICO_DE_GALLO_INIT_PRIORITY (default 40). This controller
	  configures every pin named in its cs-gpios property as an inactive
	  output at initialization, so the Pico de Gallo GPIO port owning those
	  pins has to be ready first.

	  Kconfig cannot check the arithmetic. Runtime readiness is
	  authoritative instead: an inverted priority makes initialization
	  return -ENODEV before any pin is configured, rather than actuating the
	  wrong line.

config HEAP_MEM_POOL_ADD_SIZE_PDG_SPI
	int "Heap memory pool size for the Pico de Gallo SPI driver"
	default 8192
	depends on SPI_PICO_DE_GALLO
	help
	  pdg_spi_transceive() flattens the caller's scatter-gather buffers into
	  contiguous ones with k_malloc(), one per direction, each at most
	  PDG_SPI_MAX_BUFFER (4096) bytes. A full-size duplex transfer therefore
	  needs about 8 KiB live at once.

	  This has to be declared rather than assumed: k_malloc() lives in
	  kernel/mempool.c, which Zephyr only compiles when the system heap is
	  non-empty, and CONFIG_HEAP_MEM_POOL_SIZE defaults to 0. Without a
	  contribution here the driver fails to link with an undefined reference
	  to k_malloc. The kernel sums every HEAP_MEM_POOL_ADD_SIZE_* symbol and
	  raises the pool to fit, so applications do not have to set
	  CONFIG_HEAP_MEM_POOL_SIZE by hand.

	  Lower this if you know your transfers are small.
```
